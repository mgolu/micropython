## ports/zephyr/boards/nrf9160dk_nrf9160_ns.conf
```kconfig
# General config
CONFIG_NEWLIB_LIBC=y
CONFIG_NEWLIB_LIBC_FLOAT_PRINTF=y
CONFIG_ASSERT=y
CONFIG_REBOOT=y
CONFIG_FPU=y

# Heap and stacks
CONFIG_HEAP_MEM_POOL_SIZE=16384
CONFIG_MAIN_STACK_SIZE=4736
CONFIG_SYSTEM_WORKQUEUE_STACK_SIZE=4096
CONFIG_HW_STACK_PROTECTION=y

# MCUBOOT
CONFIG_BOOTLOADER_MCUBOOT=y
CONFIG_IMG_MANAGER=y
CONFIG_STREAM_FLASH=y
CONFIG_DEBUG_OPTIMIZATIONS=n
CONFIG_TFM_CMAKE_BUILD_TYPE_DEBUG=n

# Hardware features
CONFIG_I2C=y
CONFIG_SPI=y

# Flash drivers
CONFIG_FLASH=y
CONFIG_FLASH_MAP=y
CONFIG_FLASH_PAGE_LAYOUT=y

# Network (offload sockets to the modem)
CONFIG_NETWORKING=y
CONFIG_NET_SOCKETS=y
CONFIG_NET_SOCKETS_POSIX_NAMES=y
CONFIG_NET_PKT_RX_COUNT=8
CONFIG_NET_PKT_TX_COUNT=8
CONFIG_NET_NATIVE=n
CONFIG_DNS_RESOLVER=n
CONFIG_NET_CONFIG_NEED_IPV6=n
CONFIG_NET_CONFIG_NEED_IPV4=n
CONFIG_NET_DHCPV4=n

CONFIG_POSIX_CLOCK=y

CONFIG_LTE_LINK_CONTROL=y
CONFIG_LTE_AUTO_INIT_AND_CONNECT=n
CONFIG_NRF_MODEM_LIB=y
CONFIG_PM_DEVICE=y

# Enable external flash
CONFIG_SPI=y
CONFIG_SPI_NOR=y
CONFIG_SPI_NOR_SFDP_DEVICETREE=y
CONFIG_PM_OVERRIDE_EXTERNAL_DRIVER_CHECK=y
```

## ports/zephyr/boards/nucleo_wb55rg.conf
```kconfig
CONFIG_CONSOLE_SUBSYS=n
CONFIG_NETWORKING=n

# Include overlay-bluetooth.conf in build to add Bluetooth support
```

## ports/zephyr/boards/thing91_nrf9160_ns.conf
```kconfig
# General config
CONFIG_NEWLIB_LIBC=y
CONFIG_NEWLIB_LIBC_FLOAT_PRINTF=y
CONFIG_ASSERT=y
CONFIG_REBOOT=y
CONFIG_FPU=y

# Heap and stacks
CONFIG_HEAP_MEM_POOL_SIZE=16384
CONFIG_MAIN_STACK_SIZE=20480
CONFIG_SYSTEM_WORKQUEUE_STACK_SIZE=4096
CONFIG_HW_STACK_PROTECTION=y
CONFIG_MICROPY_HEAP_SIZE=98304
CONFIG_AT_MONITOR_HEAP_SIZE=2048

# MCUBOOT
CONFIG_BOOTLOADER_MCUBOOT=y
CONFIG_IMG_MANAGER=y
CONFIG_STREAM_FLASH=y
CONFIG_DEBUG_OPTIMIZATIONS=n
CONFIG_TFM_CMAKE_BUILD_TYPE_DEBUG=n

# Hardware features
CONFIG_I2C=y
CONFIG_SPI=y

# Flash drivers
CONFIG_FLASH=y
CONFIG_FLASH_MAP=y
CONFIG_FLASH_PAGE_LAYOUT=y
CONFIG_STREAM_FLASH_ERASE=y

# Network (offload sockets to the modem)
CONFIG_NETWORKING=y
CONFIG_NET_SOCKETS=y
CONFIG_NET_SOCKETS_POSIX_NAMES=y
CONFIG_NET_PKT_RX_COUNT=8
CONFIG_NET_PKT_TX_COUNT=8
CONFIG_NET_NATIVE=n
CONFIG_DNS_RESOLVER=n
CONFIG_NET_CONFIG_NEED_IPV6=y
CONFIG_NET_CONFIG_NEED_IPV4=y
CONFIG_NET_DHCPV4=n

CONFIG_POSIX_CLOCK=y

CONFIG_LTE_LINK_CONTROL=y
CONFIG_NRF_MODEM_LIB=y
CONFIG_PM_DEVICE=y
CONFIG_PDN=y

# Location
CONFIG_LOCATION=y
CONFIG_LOCATION_METHOD_GNSS=y
CONFIG_LOCATION_METHOD_CELLULAR=y
CONFIG_LOCATION_DATA_DETAILS=y

# nRF Cloud (for A-GNSS and cell location)
CONFIG_LOCATION_SERVICE_EXTERNAL=y
CONFIG_NRF_CLOUD_AGNSS=y
CONFIG_MODEM_INFO=y
CONFIG_MODEM_INFO_ADD_NETWORK=y

# Library that maintains the current date time UTC for A-GNSS and P-GPS purposes
CONFIG_DATE_TIME=y

# Modem JWT
CONFIG_MODEM_JWT=y
```

## ports/zephyr/child_image/mcuboot/boards/nrf7002dk_nrf5340_cpuapp.conf
```kconfig
# MCUboot requires a large stack size, otherwise an MPU fault will occur
CONFIG_MAIN_STACK_SIZE=16384

# Flash drivers
CONFIG_FLASH=y
CONFIG_BOOT_MAX_IMG_SECTORS=256

# Required by USB and QSPI
CONFIG_MULTITHREADING=y

CONFIG_SPI_NOR=y
CONFIG_SPI_NOR_FLASH_LAYOUT_PAGE_SIZE=4096
CONFIG_PM_OVERRIDE_EXTERNAL_DRIVER_CHECK=y

CONFIG_LOG=n

# MCUBoot serial
CONFIG_GPIO=y
CONFIG_MCUBOOT_SERIAL=y
CONFIG_MCUBOOT_SERIAL_DIRECT_IMAGE_UPLOAD=y
CONFIG_BOOT_SERIAL_CDC_ACM=y

# USB
CONFIG_USB_DEVICE_REMOTE_WAKEUP=n
CONFIG_USB_DEVICE_MANUFACTURER="Nordic Semiconductor ASA"
CONFIG_USB_DEVICE_PRODUCT="MCUBoot nRF7002DK"
CONFIG_USB_DEVICE_VID=0x1915
CONFIG_USB_DEVICE_PID=0x5300
CONFIG_USB_CDC_ACM=y

CONFIG_BOOT_UPGRADE_ONLY=y
CONFIG_PCD_APP=y
CONFIG_UPDATEABLE_IMAGE_NUMBER=2
CONFIG_FLASH_SIMULATOR=y
CONFIG_FLASH_SIMULATOR_DOUBLE_WRITES=y
CONFIG_FLASH_SIMULATOR_STATS=n
CONFIG_NRF53_MULTI_IMAGE_UPDATE=y
```

## ports/zephyr/child_image/mcuboot/boards/nrf9160dk_nrf9160.conf
```kconfig
CONFIG_MAIN_STACK_SIZE=2048

# Flash drivers
CONFIG_FLASH=y
CONFIG_BOOT_MAX_IMG_SECTORS=256

CONFIG_SPI=y
CONFIG_SPI_NOR=y
CONFIG_SPI_NOR_FLASH_LAYOUT_PAGE_SIZE=4096
CONFIG_SPI_NOR_SFDP_DEVICETREE=y

CONFIG_PM_PARTITION_SIZE_MCUBOOT=0x18000
CONFIG_PM_OVERRIDE_EXTERNAL_DRIVER_CHECK=y

CONFIG_MULTITHREADING=y
```
